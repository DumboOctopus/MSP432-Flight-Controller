/**
 * @cliArgs --board "/ti/boards/MSP_EXP432P401R" --product "simplelink_msp432p4_sdk@3.40.01.02"
 * @versions {"tool":"1.9.0+2015","templates":null}
 */

/**
 * Import the modules used in this configuration.
 */
const GPIO  = scripting.addModule("/ti/drivers/GPIO");
const GPIO1 = GPIO.addInstance();
const GPIO2 = GPIO.addInstance();
const PWM   = scripting.addModule("/ti/drivers/PWM", {}, false);
const PWM1  = PWM.addInstance();
const RTOS  = scripting.addModule("/ti/drivers/RTOS");
const UART  = scripting.addModule("/ti/drivers/UART");
const UART1 = UART.addInstance();
const UART2 = UART.addInstance();

/**
 * Write custom configuration values to the imported modules.
 */
GPIO1.$hardware          = system.deviceData.board.components.LED1_RED;
GPIO1.$name              = "CONFIG_GPIO_LED_0";
GPIO1.initialOutputState = "High";

GPIO2.$name           = "CONFIG_GPIO_UART_CTRL";
GPIO2.mode            = "Output";
GPIO2.gpioPin.$assign = "expansion.17";

PWM1.$name                = "CONFIG_PWM_AILERON";
PWM1.timer.pwmPin.$assign = "boosterpack.40";

const Power                   = scripting.addModule("/ti/drivers/Power", {}, false);
Power.performanceLevel3.$name = "ti_drivers_power_PowerMSP432PerfLevels0";
Power.performanceLevel2.$name = "ti_drivers_power_PowerMSP432PerfLevels1";
Power.performanceLevel1.$name = "ti_drivers_power_PowerMSP432PerfLevels2";
Power.performanceLevel0.$name = "ti_drivers_power_PowerMSP432PerfLevels3";

RTOS.name = "FreeRTOS";

UART1.$name     = "CONFIG_UART_0";
UART1.$hardware = system.deviceData.board.components.XDS110UART;

UART2.$name        = "CONFIG_UART_1";
UART2.uart.$assign = "EUSCI_A3";

/**
 * Pinmux solution for unlocked pins/peripherals. This ensures that minor changes to the automatic solver in a future
 * version of the tool will not impact the pinmux you originally saw.  These lines can be completely deleted in order to
 * re-solve from scratch.
 */
GPIO1.gpioPin.$suggestSolution    = "ball.4";
PWM1.timer.$suggestSolution       = "Timer_A0";
UART1.uart.$suggestSolution       = "EUSCI_A0";
UART1.uart.txPin.$suggestSolution = "ball.7";
UART1.uart.rxPin.$suggestSolution = "ball.6";
UART2.uart.txPin.$suggestSolution = "expansion.22";
UART2.uart.rxPin.$suggestSolution = "expansion.19";
